## prj.conf
```kconfig
CONFIG_LOG=y
CONFIG_LOG_MODE_MINIMAL=y
CONFIG_LOG_DEFAULT_LEVEL=4
CONFIG_RTIO=y
CONFIG_RTIO_SYS_MEM_BLOCKS=y
CONFIG_SYS_MEM_BLOCKS=y
```

## src/main.c
```c
/*
 * Copyright (c) 2022 Intel Corporation
 *
 * SPDX-License-Identifier: Apache-2.0
 */

#include <zephyr/kernel.h>
#include <zephyr/rtio/rtio.h>
#include <zephyr/rtio/rtio_executor_simple.h>
#include <zephyr/logging/log.h>

LOG_MODULE_REGISTER(main);

#define N		(8)
#define M		(N/2)
#define SQ_SZ		(N)
#define CQ_SZ		(N)

#define NODE_ID		DT_COMPAT_GET_ANY_STATUS_OKAY(vnd_sensor)
#define SAMPLE_PERIOD	DT_PROP(NODE_ID, sample_period)
#define SAMPLE_SIZE	DT_PROP(NODE_ID, sample_size)
#define PROCESS_TIME	((M - 1) * SAMPLE_PERIOD)

RTIO_EXECUTOR_SIMPLE_DEFINE(simple_exec);
RTIO_DEFINE_WITH_MEMPOOL(ez_io, (struct rtio_executor *)&simple_exec, SQ_SZ, CQ_SZ, N, SAMPLE_SIZE,
			 4);

void main(void)
{
	const struct device *const vnd_sensor = DEVICE_DT_GET(NODE_ID);
	struct rtio_iodev *iodev = vnd_sensor->data;

	/* Fill the entire submission queue. */
	for (int n = 0; n < N; n++) {
		struct rtio_sqe *sqe = rtio_spsc_acquire(ez_io.sq);

		rtio_sqe_read_with_pool(sqe, iodev, RTIO_PRIO_HIGH, NULL);
		rtio_spsc_produce(ez_io.sq);
	}

	while (true) {
		int m = 0;
		uint8_t *userdata[M];

		LOG_INF("Submitting %d read requests", M);
		rtio_submit(&ez_io, M);

		/* Consume completion events until there is enough sensor data
		 * available to execute a batch processing algorithm, such as
		 * an FFT.
		 */
		while (m < M) {
			struct rtio_cqe *cqe = rtio_spsc_consume(ez_io.cq);

			if (cqe == NULL) {
				LOG_DBG("No completion events available");
				k_msleep(SAMPLE_PERIOD);
				continue;
			}
			LOG_DBG("Consumed completion event %d", m);

			if (cqe->result < 0) {
				LOG_ERR("Operation failed");
			}

			userdata[m] = rtio_cqe_get_mempool_buffer(&ez_io, cqe);
			rtio_spsc_release(ez_io.cq);
			m++;
		}

		/* Here is where we would execute a batch processing algorithm.
		 * Model as a long sleep that takes multiple sensor sample
		 * periods. The sensor driver can continue reading new data
		 * during this time because we submitted more buffers into the
		 * queue than we needed for the batch processing algorithm.
		 */
		LOG_INF("Start processing %d samples", M);
		for (m = 0; m < M; m++) {
			LOG_HEXDUMP_DBG(userdata[m], SAMPLE_SIZE, "Sample data:");
		}
		k_msleep(PROCESS_TIME);
		LOG_INF("Finished processing %d samples", M);

		/* Recycle the sensor data buffers and refill the submission
		 * queue.
		 */
		for (m = 0; m < M; m++) {
			struct rtio_sqe *sqe = rtio_spsc_acquire(ez_io.sq);

			rtio_release_buffer(&ez_io, userdata[m]);
			rtio_sqe_read_with_pool(sqe, iodev, RTIO_PRIO_HIGH, NULL);
			rtio_spsc_produce(ez_io.sq);
		}
	}
}
```

## src/vnd_sensor.c
```c
/*
 * Copyright (c) 2022 Intel Corporation
 *
 * SPDX-License-Identifier: Apache-2.0
 */

#define DT_DRV_COMPAT vnd_sensor

#include <zephyr/kernel.h>
#include <zephyr/rtio/rtio.h>
#include <zephyr/logging/log.h>
#include <zephyr/sys/util.h>

LOG_MODULE_REGISTER(vnd_sensor, LOG_LEVEL_DBG);

struct vnd_sensor_config {
	uint32_t sample_period;
	size_t sample_size;
};

struct vnd_sensor_data {
	struct rtio_iodev iodev;
	struct mpsc io_q;
	struct k_timer timer;
	const struct device *dev;
	uint32_t sample_number;
};

static int vnd_sensor_iodev_read(const struct device *dev, uint8_t *buf,
		uint32_t buf_len)
{
	const struct vnd_sensor_config *config = dev->config;
	struct vnd_sensor_data *data = dev->data;
	uint32_t sample_number;
	uint32_t key;

	LOG_DBG("%s: buf_len = %d, buf = %p", dev->name, buf_len, buf);

	key = irq_lock();
	sample_number = data->sample_number++;
	irq_unlock(key);

	if (buf_len < config->sample_size) {
		LOG_ERR("%s: Buffer is too small", dev->name);
		return -ENOMEM;
	}

	for (int i = 0; i < MIN(config->sample_size, buf_len); i++) {
		buf[i] = sample_number * config->sample_size + i;
	}

	return 0;
}

static void vnd_sensor_iodev_execute(const struct device *dev,
		struct rtio_sqe *iodev_sqe)
{
	const struct vnd_sensor_config *config = dev->config;
	uint8_t *buf = NULL;
	uint32_t buf_len;
	int result;

	if (iodev_sqe->op == RTIO_OP_RX) {
		result = rtio_sqe_rx_buf(iodev_sqe, config->sample_size, config->sample_size, &buf,
					 &buf_len);
		if (result != 0) {
			LOG_ERR("Failed to get RX buffer");
		} else {
			result = vnd_sensor_iodev_read(dev, buf, buf_len);
		}
	} else {
		LOG_ERR("%s: Invalid op", dev->name);
		result = -EINVAL;
	}

	if (result < 0) {
		rtio_iodev_sqe_err(iodev_sqe, result);
	} else {
		rtio_iodev_sqe_ok(iodev_sqe, result);
	}
}

static void vnd_sensor_iodev_submit(struct rtio_sqe *iodev_sqe)
{
	struct vnd_sensor_data *data = (struct vnd_sensor_data *) iodev_sqe->iodev;

	mpsc_push(&data->io_q, &iodev_sqe->q);
}

static void vnd_sensor_handle_int(const struct device *dev)
{
	struct vnd_sensor_data *data = dev->data;
	struct mpsc_node *node = mpsc_pop(&data->io_q);

	if (node != NULL) {
		struct rtio_sqe *iodev_sqe = CONTAINER_OF(node,
							  struct rtio_sqe, q);

		vnd_sensor_iodev_execute(dev, iodev_sqe);
	} else {
		LOG_ERR("%s: Could not get a msg", dev->name);
	}
}

static void vnd_sensor_timer_expiry(struct k_timer *timer)
{
	struct vnd_sensor_data *data =
		CONTAINER_OF(timer, struct vnd_sensor_data, timer);

	vnd_sensor_handle_int(data->dev);
}

static int vnd_sensor_init(const struct device *dev)
{
	const struct vnd_sensor_config *config = dev->config;
	struct vnd_sensor_data *data = dev->data;
	uint32_t sample_period = config->sample_period;

	data->dev = dev;

	mpsc_init(&data->io_q);

	k_timer_init(&data->timer, vnd_sensor_timer_expiry, NULL);

	k_timer_start(&data->timer, K_MSEC(sample_period),
		      K_MSEC(sample_period));

	return 0;
}

static const struct rtio_iodev_api vnd_sensor_iodev_api = {
	.submit = vnd_sensor_iodev_submit,
};

#define VND_SENSOR_INIT(n)                                                                         \
                                                                                                   \
	static const struct vnd_sensor_config vnd_sensor_config_##n = {                            \
		.sample_period = DT_INST_PROP(n, sample_period),                                   \
		.sample_size = DT_INST_PROP(n, sample_size),                                       \
	};                                                                                         \
                                                                                                   \
	static struct vnd_sensor_data vnd_sensor_data_##n = {                                      \
		.iodev =                                                                           \
			{                                                                          \
				.api = &vnd_sensor_iodev_api,                                      \
			},                                                                         \
	};                                                                                         \
                                                                                                   \
	DEVICE_DT_INST_DEFINE(n, vnd_sensor_init, NULL, &vnd_sensor_data_##n,                      \
			      &vnd_sensor_config_##n, POST_KERNEL,                                 \
			      CONFIG_KERNEL_INIT_PRIORITY_DEVICE, NULL);

DT_INST_FOREACH_STATUS_OKAY(VND_SENSOR_INIT)
```
