## CMakeLists.txt
```
# SPDX-License-Identifier: Apache-2.0

cmake_minimum_required(VERSION 3.20.0)

#set(SHIELD x_nucleo_iks01a3)

find_package(Zephyr REQUIRED HINTS $ENV{ZEPHYR_BASE})
project(mosyn)


FILE(GLOB app_sources src/*.c)
target_sources(app PRIVATE ${app_sources})
```

## prj.conf
```kconfig
CONFIG_ARM_MPU=n
CONFIG_BUILD_OUTPUT_HEX=y
CONFIG_LOG=y
#CONFIG_LOG_MODE_MINIMAL=y
CONFIG_RTIO=y
CONFIG_RTIO_EXECUTOR_CONCURRENT=y
CONFIG_RTIO_SUBMIT_SEM=y
CONFIG_I2S=y
CONFIG_I2S_LOG_LEVEL_INF=y

# TODO move this to a baord config
CONFIG_I2S_MCUX_SAI=y
CONFIG_DMA_TCD_QUEUE_SIZE=8

# Once shield is sorted out
CONFIG_I2C=y
#CONFIG_SENSOR=y
#CONFIG_SENSOR_LOG_LEVEL_DBG=y
#CONFIG_HTS221=y
#CONFIG_HTS221_TRIGGER_NONE=y
#CONFIG_LPS22HH=y
#CONFIG_LPS22HH_TRIGGER_OWN_THREAD=y
#CONFIG_STTS751=y
#CONFIG_STTS751_TRIGGER_NONE=y
#CONFIG_LIS2MDL=y
#CONFIG_LIS2MDL_TRIGGER_NONE=y
#CONFIG_LIS2DW12=y
#CONFIG_LIS2DW12_TRIGGER_OWN_THREAD=y
#CONFIG_LSM6DSO=y
#CONFIG_LSM6DSO_ENABLE_TEMP=n
#CONFIG_LSM6DSO_TRIGGER_OWN_THREAD=y
#CONFIG_CBPRINTF_FP_SUPPORT=y
```

## src/main.c
```c
/*
 * Copyright (c) 2022 Intel Corporation
 *
 * SPDX-License-Identifier: Apache-2.0
 */

#include "device.h"
#include "lis2mdl.h"
#include "lsm6dso.h"
#include "wm8960.h"

#include <zephyr/rtio/rtio.h>
#include <zephyr/drivers/i2s.h>
#include <zephyr/drivers/i2c.h>
#include <zephyr/kernel.h>

static struct rtio_wm8960 wm8960;

/*
static struct rtio_lis2mdl lis2mdl;
static struct rtio_lsm6dso lsm6dso;
*/


static struct i2s_config i2s_cfg;

#include <zephyr/logging/log.h>
LOG_MODULE_REGISTER(mosyn, LOG_LEVEL_DBG);

#define SAMPLE_NO 32

/* The data_l represent a sine wave */
static int16_t data_l[SAMPLE_NO] = {
	  6392,  12539,  18204,  23169,  27244,  30272,  32137,  32767,  32137,
	 30272,  27244,  23169,  18204,  12539,   6392,      0,  -6393, -12540,
	-18205, -23170, -27245, -30273, -32138, -32767, -32138, -30273, -27245,
	-23170, -18205, -12540,  -6393,     -1,
};

/* The data_r represent a sine wave with double the frequency of data_l */
static int16_t data_r[SAMPLE_NO] = {
	 12539,  23169,  30272,  32767,  30272,  23169,  12539,      0, -12540,
	-23170, -30273, -32767, -30273, -23170, -12540,     -1,  12539,  23169,
	 30272,  32767,  30272,  23169,  12539,      0, -12540, -23170, -30273,
	-32767, -30273, -23170, -12540,     -1,
};

#define FRAME_CLK_FREQ 44100
#define TIMEOUT 10
#define BLOCK_SIZE (2 * sizeof(data_l))
#define NUM_TX_BLOCKS 4


/**
 * Fill a block with predefined data (data_r, data_l)
 * with bit shift attenuation
 */
static void fill_buf(int16_t *tx_block, int att)
{
	for (int i = 0; i < SAMPLE_NO; i++) {
		tx_block[2 * i] = data_l[i] >> att;
		tx_block[2 * i + 1] = data_r[i] >> att;
	}
}

int main()
{
	//lsm6dso_configure(&lsm6dso);
	//lis2mdl_configure(&lis2mdl);
	//wm8960_configure(&wm8960);

	LOG_INF("Motion Synthesizer!\n");

	int ret;

	const struct device *i2s_dev = DEVICE_DT_GET(DT_NODELABEL(sai1));
	const struct device *i2c_dev = DEVICE_DT_GET(DT_NODELABEL(lpi2c1));

	__ASSERT(i2c_dev != NULL, "expected a valid i2c device");
	__ASSERT(i2s_dev != NULL, "expected a valid i2s device");

	wm8960_configure(&wm8960, i2c_dev, i2s_dev);

	int16_t tx_block[SAMPLE_NO];

	/* i2s_buf_write wants to copy, so setup a buf here then copy it in */
	for (int i = 0; i < NUM_TX_BLOCKS; i++) {
		LOG_INF("filling buf");
		fill_buf((uint16_t *)tx_block, 0);
		LOG_INF("writing buf");
		i2s_buf_write(i2s_dev, tx_block, sizeof(tx_block));
	}

	LOG_INF("trigging i2s");
	i2s_trigger(i2s_dev, I2S_DIR_TX, I2S_TRIGGER_START);

	while (true) {
	for (int i = 0; i < 256; i++) {
		fill_buf((uint16_t *)tx_block, 0);
		i2s_buf_write(i2s_dev, tx_block, sizeof(tx_block));
	}
	LOG_INF("wrote 128 blocks to i2s");
	}

	/* start threads for pipeline, each one pulls (reads) from the previous
	 * but the alternative is also possible where the sensor reads trigger
	 * writes (push) */
	/* k_thread_create(orientation); */
	/* k_thread_create(audiosynth); */

	/* Initialize start feeding the pipeline */
	/* rtio_prep_read(r, &lsm6dso, ...) */
	/* rtio_prep_read(r, &lis2mdl, ...) */
	/* rtio_submit(r, 0) */
	/* rtio */
}
```

## src/lsm6dso.h
```c
/*
 * Copyright (c) 2022 Intel Corporation
 *
 * SPDX-License-Identifier: Apache-2.0
 */

/**
 * Simple driver over a LSM6DSO that provides an rtio iodev
 *
 * Ideally this uses a sensor driver that works with RTIO instead.
 */
#ifndef LSM6DSO_H_
#define LSM6DSO_H_

#include <rtio/rtio.h>

struct rtio_lsm6dso {
	struct rtio_iodev iodev;
};

void lsm6dso_configure(struct rtio_lsm6dso *iodev);

#endif /* LSM6DSO_H_ */
```

## src/wm8960.c
```c
#include "wm8960.h"
#include <zephyr/drivers/i2c.h>
#include <zephyr/drivers/i2s.h>
#include <zephyr/kernel.h>

static const uint8_t wm8960_init_seq[][2] = {
	WM8960_PAIR(WM8960_RESET, 0),     /* Reset to defaults */
	WM8960_PAIR(WM8960_PWR1, 0x01FE), /* Everything on (vmid, vref, ain, adc, micb, digenb) */
	WM8960_PAIR(WM8960_PWR2, 0x01FF), /* Everything on (dac, spk, out3, pll) */
	WM8960_PAIR(WM8960_PWR3, 0x001F), /* Everything on (mixers/mics) */
	WM8960_PAIR(WM8960_IFACE1,0x0002), /* Slave mode, Word Length 16 bits, Format I2S */
	WM8960_PAIR(WM8960_LDAC, 0x01FF), /* 0dB */
	WM8960_PAIR(WM8960_RDAC, 0x01FF), /* 0dB */
	WM8960_PAIR(WM8960_LOUT1, 0x016F), /* 0dB */
	WM8960_PAIR(WM8960_ROUT1, 0x016F), /* 0dB */
	WM8960_PAIR(WM8960_LMIX, 0x0100), /* DAC routing */
	WM8960_PAIR(WM8960_RMIX, 0x0100), /* DAC routing */
	WM8960_PAIR(WM8960_CTL2, 0x0004), /* Unmute ramp volume */
	WM8960_PAIR(WM8960_CTL1, 0x0000), /* Unmute */
	WM8960_PAIR(WM8960_CLASSD1, 0x00F7) /* enable class d */
};

K_MEM_SLAB_DEFINE(tx_mem_slab, 128, 4, 32);

/**
 * Sets up the WM8960 as a RTIO IODEV
 *
 * With a DAC input and Headphone Output
 */
void wm8960_configure(struct rtio_wm8960 *wm8960,
		      const struct device *i2c,
		      const struct device *i2s)
{
	int ret;

	wm8960->i2c = i2c;
	wm8960->i2s = i2s;

	for(int i = 0; i < ARRAY_SIZE(wm8960_init_seq); i++) {
		ret = i2c_write(wm8960->i2c, wm8960_init_seq[i], 2, WM8960_ADDR);
		__ASSERT(ret == 0, "Failed to write out wm8960 init sequence");
	}

	struct i2s_config i2s_cfg;

	i2s_cfg.word_size = 16U;
	i2s_cfg.channels = 2U;
	i2s_cfg.format = I2S_FMT_DATA_FORMAT_I2S;
	i2s_cfg.frame_clk_freq = 44100;
	i2s_cfg.block_size = 128;
	i2s_cfg.timeout = 1000;
	i2s_cfg.options = I2S_OPT_FRAME_CLK_MASTER | I2S_OPT_BIT_CLK_MASTER;
	i2s_cfg.mem_slab = &tx_mem_slab;

	ret = i2s_configure(wm8960->i2s, I2S_DIR_TX, &i2s_cfg);
}
```

## src/wm8960.h
```c
/*
 * Copyright (c) 2022 Intel Corporation
 *
 * SPDX-License-Identifier: Apache-2.0
 */

/**
 * Simple driver over a WM8960 codec that provides an rtio iodev
 *
 * Ideally this uses a codec/i2s driver that works with RTIO instead.
 */
#ifndef WM8960_H_
#define WM8960_H_

#include <zephyr/rtio/rtio.h>
#include <zephyr/drivers/i2c.h>
#include <zephyr/drivers/i2s.h>
#include <zephyr/kernel.h>

struct rtio_wm8960 {
	struct rtio_iodev iodev;
	const struct device *i2c;
	const struct device *i2s;
};

void wm8960_configure(struct rtio_wm8960 *wm8960,
		      const struct device *i2c,
		      const struct device *i2s);

#define WM8960_ADDR   0x1A
#define WM8960_VMASK  0x01FF
#define WM8960_REGSHIFT(x) (x << 1)
#define WM8960_VALH(val) ((val >> 8) && 0x01)
#define WM8960_VALL(val) (val && 0xFF)

/* Generate a pair of values for high and low bytes */
#define WM8960_PAIR(reg, val) {WM8960_REGSHIFT(reg) | WM8960_VALH(val), WM8960_VALL(val)}

#define WM8960_LIN      0x00
#define WM8960_RINL     0x01
#define WM8960_LOUT1    0x02
#define WM8960_ROUT1    0x03
#define WM8960_CLOCK1   0x04
#define WM8960_CTL1     0x05
#define WM8960_CTL2     0x06
#define WM8960_IFACE1   0x07
#define WM8960_CLOCK2   0x08
#define WM8960_IFACE2   0x09
#define WM8960_LDAC     0x0A
#define WM8960_RDAC     0x0B
#define WM8960_RESET    0x0F
#define WM8960_3DCTL    0x10
#define WM8960_ALC1     0x11
#define WM8960_ALC2     0x12
#define WM8960_ALC3     0x13
#define WM8960_NGATE    0x14
#define WM8960_LADC     0x15
#define WM8960_RADC     0x16
#define WM8960_ACTL1    0x17
#define WM8960_ACTL2    0x18
#define WM8960_PWR1     0x19
#define WM8960_PWR2     0x1A
#define WM8960_ACTL3    0x1B
#define WM8960_APOP1    0x1C
#define WM8960_APOP2    0x1D
#define WM8960_ADCL     0x20
#define WM8960_ADCR     0x21
#define WM8960_LMIX     0x22
#define WM8960_RMIX     0x25
#define WM8960_MMIX     0x27
#define WM8960_LOUT2    0x28
#define WM8960_ROUT2    0x29
#define WM8960_MONOOUT  0x2A
#define WM8960_BOOST1   0x2B
#define WM8960_BOOST2   0x2C
#define WM8960_BYPASS1  0x2D
#define WM8960_BYPASS2  0x2E
#define WM8960_PWR3     0x2F
#define WM8960_ACTL4    0x30
#define WM8960_CLASSD1  0x31
#define WM8960_CLASSD3  0x33
#define WM8960_PLLN     0x34
#define WM8960_PLLK1    0x35
#define WM8960_PLLK2    0x36
#define WM8960_PLLK3    0x37

#endif /* WM8960_H_ */
```
