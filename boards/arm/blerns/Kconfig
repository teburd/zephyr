## dts/bindings/sensor/st,lis3mdl-i2c.yaml
```yaml
#
# Copyright (c) 2017, Linaro Limited
#
# SPDX-License-Identifier: Apache-2.0
#
---
title: STMicroelectronics MEMS sensors LIS3MDL
version: 0.1

description: >
    This binding gives a base representation of LIS3MDL 3-axis magnetometer 

inherits:
    !include i2c-device.yaml

properties:
    compatible:
      constraint: "st,lis3mdl"

    irq-gpios:
      type: compound
      category: required
      generation: define, use-prop-name
...
```

## dts/bindings/sensor/st,lis3mdl-spi.yaml
```yaml
#
# Copyright (c) 2018, Linaro Limited
#
# SPDX-License-Identifier: Apache-2.0
#
---
title: STMicroelectronics MEMS sensors LIS3MDL SPI
version: 0.1

description: >
    This binding gives a base representation of LIS3MDL 3-axis magnetometer

inherits:
    !include spi-device.yaml

properties:
    compatible:
        constraint: "st,lis3mdl"

    drdy-gpios:
      type: compound
      category: optional
      generation: define, use-prop-name

    irq-gpios:
      type: compound
      category: required
      generation: define, use-prop-name

...
```

## dts/bindings/sensor/tdk,icm20649-spi.yaml
```yaml
#
# Copyright (c) 2019, Transitchatter Group LLC
#
# SPDX-License-Identifier: Apache-2.0
#
---
title: TDK MEMS sensors ICM20649 SPI
version: 0.1

description: >
    This binding gives a base representation of ICM20649 6-axis accelerometer
    and gyrometer accessed through SPI bus

inherits:
    !include spi-device.yaml

properties:
    compatible:
        constraint: "tdk,icm20649"

    irq-gpios:
      type: compound
      category: required
      generation: define, use-prop-name
...
```

## tests/subsys/modules/testcase.yaml
```yaml
common:
  tags: modules
tests:
  modules.simple.arm:
    arch_allow: arm
    extra_configs:
      - CONFIG_ARM_MPU=n
```
