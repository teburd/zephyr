## boards/arm/blerns/Kconfig
```kconfig
# Kconfig - nRF52840 PCA10056 board configuration
#
# Copyright (c) 2016 Nordic Semiconductor ASA
#
# SPDX-License-Identifier: Apache-2.0

if BOARD_BLERNS

config BOARD_ENABLE_DCDC
        bool "Enable DCDC mode"
        select SOC_DCDC_NRF52X
        default n

endif # BOARD_NRF52840_PCA10056
```

## boards/arm/blerns/Kconfig.board
```kconfig
# Kconfig - nRF52840 PCA10056 board configuration
#
# Copyright (c) 2016 Nordic Semiconductor ASA
#
# SPDX-License-Identifier: Apache-2.0

config  BOARD_BLERNS_
	bool "BLERNS"
	depends on SOC_NRF52840_QIAA
```

## boards/arm/blerns/Kconfig.defconfig
```kconfig
# Kconfig - nRF52 PCA10040 board configuration
#
# Copyright (c) 2016 Nordic Semiconductor ASA
#
# SPDX-License-Identifier: Apache-2.0
#
if BOARD_BLERNS

config BOARD
	default "blerns"

if ADC

config ADC_0
	default y

endif # ADC

if I2C

config I2C_0
	default y

endif # I2C

if SPI

config SPI_1
	default y

endif # SPI

if USB

config USB_NRF52840
	default y

config USB_DEVICE_STACK
	default y

endif # USB

if IEEE802154

config IEEE802154_NRF5
	default y

endif # IEEE802154

endif # BOARD_BLERNS
```

## boards/arm/blerns/blerns_defconfig
```kconfig
CONFIG_ARM=y
CONFIG_SOC_FAMILY_NRF=y
CONFIG_SOC_SERIES_NRF52X=y
CONFIG_SOC_NRF52840_QIAA=y
CONFIG_BOARD_BLERNS=y

# Enable MPU
CONFIG_ARM_MPU_NRF52X=y

# enable uart driver
CONFIG_SERIAL=y
CONFIG_UART_NRFX=y
CONFIG_UART_0_NRF_UART=y

# enable console
CONFIG_GPIO=y
CONFIG_USB=y
CONFIG_USB_DEVICE_STACK=y
CONFIG_CONSOLE=y
CONFIG_UART_CONSOLE=n
CONFIG_USB_UART_CONSOLE=y
CONFIG_USB_UART_DTR_WAIT=y
CONFIG_UART_INTERRUPT_DRIVEN=y
CONFIG_UART_LINE_CTRL=y

# additional board options
CONFIG_GPIO_AS_PINRESET=y

# bluetooth
CONFIG_BT=y
CONFIG_BT_CTLR=y
```

## boards/arm/boss3/Kconfig.board
```kconfig
# Kconfig - nRF52840 PCA10056 board configuration
#
# Copyright (c) 2016 Nordic Semiconductor ASA
#
# SPDX-License-Identifier: Apache-2.0

config  BOARD_BOSS3
	bool "BOSS3"
	depends on SOC_NRF52840_QIAA
```

## drivers/battery/Kconfig
```kconfig
# Battery configuration options

# Copyright (c) 2021 Intel Corporation
# SPDX-License-Identifier: Apache-2.0

menuconfig BATTERY
	bool "Battery Drivers"
	help
	  Include battery drivers in system config

if BATTERY

module = BATTERY
module-str = battery
source "subsys/logging/Kconfig.template.log_config"

config BATTERY_INIT_PRIORITY
	int "Battery init priority"
	default 10
	help
	  Battery initialization priority.

comment "Device Drivers"

source "drivers/battery/max17055/Kconfig"

endif # BATTERY
```

## drivers/dma/Kconfig.dw
```kconfig
# CAVS DMA configuration options

# Copyright (c) 2018 Intel Corporation
# SPDX-License-Identifier: Apache-2.0

# This option signifies whether DesignWare DMA compatible HW is
# available
config HAS_DMA_DW
	bool

config DMA_DW
	bool "Enable DesignWare DMA driver"
	depends on HAS_DMA_DW
	help
	  DesignWare DMA driver.
```

## drivers/led/Kconfig.lp5521
```kconfig
#
# Copyright (c) 2018 Workaround GmbH
#
# SPDX-License-Identifier: Apache-2.0
#

menuconfig LP5521
	bool "LP5521 LED driver"
	depends on I2C
	help
	  Enable LED driver for LP5521.

	  LP5521 LED driver has 3 channels (RGB). Each channel can drive up to
	  25.5 mA per LED.

if !HAS_DTS_I2C_DEVICE && LP5521

config LP5521_DEV_NAME
	string "LP5521 device name"
	default "LP5521"
	help
	  Device name for LP5521 LED driver.

config LP5521_I2C_ADDRESS
	hex "LP5521 I2C slave address"
	range 0x32 0x35
	default 0x32
	help
	  Specify the I2C slave address for the LP5521 LED driver.
	  0x32: ADR0 = 0, ADR1 = 0
	  0x33: ADR0 = 0, ADR1 = 1
	  0x34: ADR0 = 1, ADR1 = 0
	  0x35: ADR0 = 1, ADR1 = 1

config LP5521_I2C_MASTER_DEV_NAME
	string "I2C master where LP5521 is connected"
	default "I2C_0"
	help
	  Specify the device name of the I2C master device to which
	  LP5521 is connected.

endif

config LP5521_GPIO_ENABLE 
	bool "Enable GPIO enable for LP5521"
	depends on LP5521
	help
	  Enable GPIO enable support for LP5521 


config LP5521_GPIO_ENABLE_DEV_NAME
	string "GPIO device"
	default "GPIO_1"
	depends on LP5521 && LP5521_GPIO_ENABLE
	help
	  The device name of the GPIO device to which the LP5521 ENABLE
	  pin is connected.


config LP5521_GPIO_ENABLE_PIN_NUM
	int "GPIO Wakeup pin number"
	default 0
	depends on LP5521 && LP5521_GPIO_ENABLE
	help
	  The number of the GPIO pin on which the ENABLE pin of LP5521
	  is connected
```

## drivers/rtio/Kconfig
```kconfig
# Kconfig - rtio configuration options

#
# Copyright (c) 2019 Thomas Burdick <thomas.burdick@gmail.com>
#
# SPDX-License-Identifier: Apache-2.0
#

menuconfig RTIO
	bool "RTIO Drivers"
	help
	  Include rtio drivers in system config

if RTIO

module = RTIO
module-str = rtio
source "subsys/logging/Kconfig.template.log_config"

config RTIO_INIT_PRIORITY
	int "RTIO init priority"
	default 90
	help
	  RTIO initialization priority.

config RTIO_DRIVER
	bool "RTIO common driver functionality"
	default false
	help
		RTIO common driver functionality

config RTIO_RAMP
	bool "RTIO ramp driver"
	default false
	select RTIO_DRIVER
	help
		RTIO ramp driver

endif # RTIO
```

## drivers/rtio/sensor/Kconfig
```kconfig
# Kconfig - rtio_sensor configuration options

#
# Copyright (c) 2019 Thomas Burdick <thomas.burdick@gmail.com>
#
# SPDX-License-Identifier: Apache-2.0
#

menuconfig RTIO_SENSOR
	bool "RTIO Drivers"
	help
	  Include rtio drivers in system config

if RTIO_SENSOR

module = RTIO
module-str = rtio
source "subsys/logging/Kconfig.template.log_config"

config RTIO_SENSOR_INIT_PRIORITY
	int "RTIO Sensor init priority"
	default 90
	help
	  RTIO Sensor initialization priority.

comment "Device Drivers"

source "drivers/rtio/sensor/icm20649/Kconfig"

endif # RTIO_SENSOR
```

## drivers/rtio/sensor/icm20649/Kconfig
```kconfig
# Kconfig - ICM20649 high speed, high range accelerometer and gyroscope sensor
# options

#
# Copyright (c) 2018 LeanUp
# Copyright (c) 2019 Tom Burdick <tom.burdick@electromatic.us>
#
# SPDX-License-Identifier: Apache-2.0
#

menuconfig RTIO_SENSOR_ICM20649
	bool "ICM20649 SPI accelerometer and gyroscope Chip"
	depends on SENSOR && SPI
	default n
	help
	  Enable driver for ICM20649 accelerometer and gyroscope
	  sensor.

if RTIO_SENSOR_ICM20649

config ICM20649_VERIFY_WRITE
	bool "ICM20649 Verify register writes by reading back the register value"
	default n
	help
	  This option is meant to be used to debug register setup.

endif # RTIO_SENSOR
```

## drivers/sensor/icm20601/Kconfig
```kconfig
# Kconfig - ICM20601 accelerometer and gyroscope sensor configuration
# options

#
# Copyright (c) 2018 LeanUp
#
# SPDX-License-Identifier: Apache-2.0
#

menuconfig ICM20601
	bool "ICM20601 SPI accelerometer and gyroscope Chip"
	depends on SENSOR && SPI
	default n
	help
	  Enable driver for ICM20601 accelerometer and gyroscope
	  sensor.

config ICM20601_NAME
	string "ICM20601 device name"
	depends on ICM20601
	default "ICM20601"

config ICM20601_SPI_SELECT_SLAVE
	hex "ICM20601 SPI slave select pin"
	depends on ICM20601
	default 1
	help
	  ICM20601 SPI chip select pin (active low).

config ICM20601_SPI_BUS_FREQ
	int "ICM20601 SPI bus speed in Hz"
	default 8000000
	depends on ICM20601
	help
	  This is the maximum supported SPI bus frequency. The chip supports a
	  frequency up to 8MHz.

config ICM20601_SPI_MASTER_DEV_NAME
	string "SPI master name where ICM20601 chip is connected"
	depends on ICM20601
	default "SPI_2"
	help
	  Specify the device name of the spi master device to which ICM20601 is
	  connected.

config ICM20601_SPI_GPIO_CS
	bool "ICM20601 SPI CS through a GPIO pin"
	default n
	depends on ICM20601
	help
	  This option is useful if one needs to manage SPI CS through a GPIO
	  pin to by-pass the SPI controller's CS logic.

config ICM20601_SPI_GPIO_CS_DRV_NAME
	string "GPIO driver's name to use to drive SPI CS through"
	default ""
	depends on ICM20601_SPI_GPIO_CS
	help
	  This option is mandatory to set which GPIO controller to use in order
	  to actually emulate the SPI CS.

config ICM20601_SPI_GPIO_CS_PIN
	int "GPIO PIN to use to drive SPI CS through"
	default 0
	depends on ICM20601_SPI_GPIO_CS
	help
	  This option is mandatory to set which GPIO pin to use in order
	  to actually emulate the SPI CS.

choice
	prompt "Trigger mode"
	depends on ICM20601
	default ICM20601_TRIGGER_NONE
	help
	  Specify the type of triggering to be used by the driver.

config ICM20601_TRIGGER_NONE
	bool
	prompt "No trigger"

config ICM20601_TRIGGER_GLOBAL_THREAD
	bool
	prompt "Use global thread"
	depends on GPIO
	select ICM20601_TRIGGER

config ICM20601_TRIGGER_OWN_THREAD
	bool
	prompt "Use own thread"
	depends on GPIO
	select ICM20601_TRIGGER

endchoice

config ICM20601_TRIGGER
	bool
	depends on ICM20601

config ICM20601_GPIO_DEV_NAME
	string
	prompt "GPIO device"
	depends on ICM20601 && ICM20601_TRIGGER
	help
	  The device name of the GPIO device to which the ICM20601 interrupt pin
	  is connected.

config ICM20601_GPIO_PIN_NUM
	int
	prompt "Interrupt GPIO pin number"
	depends on ICM20601 && ICM20601_TRIGGER
	help
	  The number of the GPIO on which the interrupt signal from the ICM20601
	  chip will be received.

config ICM20601_THREAD_PRIORITY
	int
	prompt "Thread priority"
	depends on ICM20601 && ICM20601_TRIGGER_OWN_THREAD
	default 10
	help
	  Priority of thread used by the driver to handle interrupts.

config ICM20601_THREAD_STACK_SIZE
	int
	prompt "Thread stack size"
	depends on ICM20601 && ICM20601_TRIGGER_OWN_THREAD
	default 1024
	help
	  Stack size of thread used by the driver to handle interrupts.

config ICM20601_ENABLE_TEMP
	bool "Enable temperature"
	depends on ICM20601
	default n
	help
	  Enable/disable temperature

menu "Attributes"
	depends on ICM20601

config ICM20601_GYRO_FS
	int
	prompt "Gyroscope full-scale range"
	depends on ICM20601
	default 0
	help
	  Specify the default gyroscope full-scale range.
	  An X value for the config represents a range of +/- X degree per
	  second. Valid values are:
	  0:  Full Scale selected at runtime
	  500:   +/- 500dps
	  1000:  +/- 1000dps
	  2000:  +/- 2000dps
	  4000:  +/- 4000dps

config ICM20601_ACCEL_FS
	int
	prompt "Accelerometer full-scale range"
	depends on ICM20601
	default 0
	help
	  Specify the default accelerometer full-scale range.
	  An X value for the config represents a range of +/- X G. Valid values
	  are:
	  0:  Full Scale selected at runtime
	  2:  +/- 2g
	  4:  +/- 4g
	  8:  +/- 8g
	  16: +/- 16g
	  32: +/- 32g

endmenu
```

## drivers/sensor/icm20649/Kconfig
```kconfig
# Kconfig - ICM20649 accelerometer and gyroscope sensor configuration
# options

#
# Copyright (c) 2018 LeanUp
#
# SPDX-License-Identifier: Apache-2.0
#

menuconfig ICM20649
	bool "ICM20649 SPI accelerometer and gyroscope Chip"
	depends on SENSOR && SPI
	default n
	help
	  Enable driver for ICM20649 accelerometer and gyroscope
	  sensor.

config ICM20649_VERIFY_WRITE
	bool "ICM20649 Verify register writes read back the same value"
	default n
	depends on ICM20649
	help
	  This option is meant to be used to debug register setup.

config ICM20649_SPI_GPIO_CS
	bool "ICM20649 SPI CS through a GPIO pin"
	default n
	depends on ICM20649
	help
	  This option is useful if one needs to manage SPI CS through a GPIO
	  pin to by-pass the SPI controller's CS logic.

config ICM20649_SPI_GPIO_CS_DRV_NAME
	string "GPIO driver's name to use to drive SPI CS through"
	default ""
	depends on ICM20649_SPI_GPIO_CS
	help
	  This option is mandatory to set which GPIO controller to use in order
	  to actually emulate the SPI CS.

config ICM20649_SPI_GPIO_CS_PIN
	int "GPIO PIN to use to drive SPI CS through"
	default 0
	depends on ICM20649_SPI_GPIO_CS
	help
	  This option is mandatory to set which GPIO pin to use in order
	  to actually emulate the SPI CS.

choice
	prompt "Trigger mode"
	depends on ICM20649
	default ICM20649_TRIGGER_NONE
	help
	  Specify the type of triggering to be used by the driver.

config ICM20649_TRIGGER_NONE
	bool
	prompt "No trigger"

config ICM20649_TRIGGER_GLOBAL_THREAD
	bool
	prompt "Use global thread"
	depends on GPIO
	select ICM20649_TRIGGER

config ICM20649_TRIGGER_OWN_THREAD
	bool
	prompt "Use own thread"
	depends on GPIO
	select ICM20649_TRIGGER

endchoice

config ICM20649_TRIGGER
	bool
	depends on ICM20649

config ICM20649_THREAD_PRIORITY
	int
	prompt "Thread priority"
	depends on ICM20649 && ICM20649_TRIGGER_OWN_THREAD
	default 10
	help
	  Priority of thread used by the driver to handle interrupts.

config ICM20649_THREAD_STACK_SIZE
	int
	prompt "Thread stack size"
	depends on ICM20649 && ICM20649_TRIGGER_OWN_THREAD
	default 1024
	help
	  Stack size of thread used by the driver to handle interrupts.

config ICM20649_ENABLE_TEMP
	bool "Enable temperature"
	depends on ICM20649
	default n
	help
	  Enable/disable temperature

menu "Attributes"
	depends on ICM20649

config ICM20649_GYRO_FS
	int
	prompt "Gyroscope full-scale range"
	depends on ICM20649
	default 0
	help
	  Specify the default gyroscope full-scale range.
	  An X value for the config represents a range of +/- X degree per
	  second. Valid values are:
	  0:  Full Scale selected at runtime
	  500:   +/- 500dps
	  1000:  +/- 1000dps
	  2000:  +/- 2000dps
	  4000:  +/- 4000dps

config ICM20649_ACCEL_FS
	int
	prompt "Accelerometer full-scale range"
	depends on ICM20649
	default 0
	help
	  Specify the default accelerometer full-scale range.
	  An X value for the config represents a range of +/- X G. Valid values
	  are:
	  0:  Full Scale selected at runtime
	  2:  +/- 2g
	  4:  +/- 4g
	  8:  +/- 8g
	  16: +/- 16g
	  30: +/- 30g

endmenu
```

## drivers/sensor/icm42688/Kconfig
```kconfig
# ICM42688-P Six-Axis Motion Tracking device configuration options
#
# Copyright (c) 2022 Intel Corporation
#
# SPDX-License-Identifier: Apache-2.0

DT_COMPAT_ICM42688 := invensense,icm42688

menuconfig ICM42688
	bool "ICM42688 Six-Axis Motion Tracking Device"
	default $(dt_compat_enabled,$(DT_COMPAT_ICM42688))
	depends on SPI
	help
	  Enable driver for ICM42688 SPI-based six-axis motion tracking device.

if ICM42688

config ICM42688_THREAD_PRIORITY
	int "Thread priority"
	default 10
	help
	  Priority of thread used by the driver to handle interrupts.

config ICM42688_THREAD_STACK_SIZE
	int "Thread stack size"
	default 1024
	help
	  Stack size of thread used by the driver to handle interrupts.

menuconfig ICM42688_RTIO
	bool "ICM42688 RTIO Support"
	depends on RTIO
	help
	  Enable RTIO support for ICM42688 allowing for scatter gather like requests against the fifo.

if ICM42688_RTIO

config ICM42688_RTIO_QUEUE_SIZE
	int "Power of 2 queue size of pending read requests allowed for the rtio stream"
	depends on RTIO
	default 4
	help
	  Size of fixed size queue for pending requests to the iodev

endif # ICM42688_RTIO

endif # ICM42688
```

## dts/bindings/led/ti,lp5521.yaml
```yaml
---
title: TI LP5521 LED Driver
id: ti,lp5521
version: 0.1

description: TI LP5521 LED binding

inherits:
    !include i2c-device.yaml

properties:
    compatible:
      type: string
      category: required
      description: compatible strings
      constraint: "ti,lp5521"
...
```

## dts/bindings/rtio/tdk,icm20649-spi.yaml
```yaml
#
# Copyright (c) 2019 LeanUp Design
# Copyright (c) 2019 Tom Burdick <tom.burdick@electromatic.us>
#
# SPDX-License-Identifier: Apache-2.0
#
---
title: TDK MEMS Sensors ICM20649 SPI
version: 0.1

description: >
    This binding gives a base representation of ICM20649 6-axis accelerometer
    and gyrometer accessed through SPI bus

inherits:
    !include spi-device.yaml

properties:
    compatible:
        constraint: "tdk,icm20649"

    irq-gpios:
      type: compound
      category: required
      generation: define, use-prop-name
...
```
